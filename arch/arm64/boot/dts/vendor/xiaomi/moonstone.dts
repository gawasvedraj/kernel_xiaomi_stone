#include "../qcom/blair-qrd-nopmi.dts"
#include "moonstone-audio.dts"
#include "moonstone-camera.dts"
#include "moonstone-consumerir.dts"
#include "moonstone-display.dts"
#include "moonstone-fingerprint.dts"
#include "moonstone-memory.dts"
#include "moonstone-nfc.dts"
#include "moonstone-pinctrl.dts"
#include "moonstone-pmic.dts"
#include "moonstone-regulator.dts"
#include "moonstone-thermal.dts"
#include "moonstone-touchscreen.dts"
#include "moonstone-vibrator.dts"

&qcom {
	/delete-property/ mem-type;
	/delete-property/ console-size;
	record-size = <0x100000>;
	pmsg-size = <0x100000>;
	max-reason = <4>;
};

&ufshc_mem {
	spm-level = <3>;
};

&sdhc_2 {
	cd-gpios = <&tlmm 94 GPIO_ACTIVE_HIGH>;
};
